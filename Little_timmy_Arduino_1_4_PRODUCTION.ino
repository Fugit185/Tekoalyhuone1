#include <SPI.h>
#include <Wire.h>
#include <Adafruit_GFX.h>
#include <Adafruit_SSD1306.h>
#include <Otto.h>
#include <Otto_sounds.h>
#include <Otto_gestures.h>
#include <Otto_mouths.h>
#include "U8glib.h"
#include <Servo.h>


Servo myservo,updown;  // create servo object to control a servo
float pos = 0;    // variable to store the servo position
float ud = 79; //set the initial positiin of the neck to look up
int doorlock=7; //pin connected to door lock 
int mouth = 10;//LED in timmys mouth
//int NN= 2; //Singal coming from neural network
int startPinIn= 2; //Singal coming from ESP
int donePinOut = 5; //Signal when ready PWM
int powerOnPinOut = 6; //signal when OM PWM
int pinValue; //printing out pin status


extern uint8_t I2C_SLA; 
Otto Otto;

U8GLIB_SSD1306_128X64 u8g(U8G_I2C_OPT_NONE|U8G_I2C_OPT_DEV_0);  // I2C / TWI 

/* Images are 48x48 pixels
   Dumps can be generated from bitmap using LCD Assistant
   http://en.radzio.dxp.pl/bitmap_converter/
*/

const uint8_t heart1 []  PROGMEM = {
0x00, 0x00, 0x00, 0x00, 0x00, 0x00, 0x00, 0x00, 0x00, 0x00, 0x00, 0x00, 0x00, 0x00, 0x00, 0x00,
0x00, 0x00, 0x00, 0x3F, 0xC0, 0x03, 0xFC, 0x00, 0x00, 0xFF, 0xF0, 0x0F, 0xFF, 0x00, 0x03, 0xFF,
0xF8, 0x1F, 0xFF, 0xC0, 0x07, 0xFF, 0xFE, 0x7F, 0xFF, 0xE0, 0x0F, 0xFF, 0xFF, 0xFF, 0xFF, 0xF0,
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0x00, 0x00, 0x00, 0x00, 0x00, 0x00, 0x00, 0x00, 0x00, 0x00, 0x00, 0x00, 0x00, 0x00, 0x00, 0x00
};

const uint8_t spiral [] PROGMEM = {
0x00, 0x00, 0x00, 0x00, 0x00, 0x00, 0x00, 0x00, 0x00, 0x00, 0x00, 0x00, 0x00, 0xFF, 0xFF, 0xFF,
0xFF, 0x80, 0x00, 0xFF, 0xFF, 0xFF, 0xFF, 0x80, 0x00, 0xC0, 0x00, 0x00, 0xE1, 0x80, 0x00, 0xC0,
0x00, 0x01, 0xC3, 0x80, 0x00, 0xC0, 0x00, 0x03, 0x87, 0x80, 0x00, 0xC0, 0x00, 0x07, 0x0F, 0x80,
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0x20, 0x30, 0x78, 0x30, 0x30, 
};



const uint8_t normal [] PROGMEM = {
0xFF, 0xFF, 0xFF, 0xFF, 0xFF, 0xFF, 0xFF, 0xFF, 0xFF, 0xFF, 0xFF, 0xFF, 0xFF, 0xFF, 0xFF, 0xFF,
0xFF, 0xFF, 0xFF, 0xFF, 0xFF, 0xFF, 0xFF, 0xFF, 0xFF, 0xFF, 0xFF, 0xFF, 0xFF, 0xFF, 0xFF, 0xFF,
0xFF, 0xFF, 0xFF, 0xFF, 0xFF, 0xFF, 0xFF, 0xFF, 0xFF, 0xFF, 0xFF, 0xFF, 0xFF, 0xFF, 0xFF, 0xFF,
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0xFF, 0xFF, 0xFF, 0xFF, 0xFF, 0xFF, 0xFF, 0xFF, 0xFF, 0xFF, 0xFF, 0xFF, 0xFF, 0xFF, 0xFF, 0xFF
};

const uint8_t test [] PROGMEM = {
0x00, 0x00, 0x00, 0x00, 0x00, 0x00, 0x00, 0x00, 0x00, 0x00, 0x00, 0x00, 0x00, 0x00, 0x00, 0x00,
0x00, 0x00, 0x00, 0x00, 0x00, 0x00, 0x00, 0x00, 0x00, 0x00, 0x00, 0x00, 0x00, 0x00, 0x00, 0x00,
0x00, 0x00, 0x00, 0x00, 0x00, 0x00, 0x00, 0x00, 0x00, 0x00, 0x00, 0x00, 0x00, 0x00, 0x00, 0x00,
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0x00, 0x00, 0x00, 0x00, 0x00, 0x00, 0x00, 0x00, 0x00, 0x00, 0x00, 0x00, 0x00, 0x00, 0x00, 0x00
};
Adafruit_SSD1306 display(4);

char cmdbuffer[19];
byte cmdlen=0;
bool cmdinput   =false;
byte cmd=0;
int p2 = random(0,100);
int NNvalue;



void setup() {
  Serial.begin(9600);
  //Serial.println("setup alkaa");
  myservo.attach(3);  // attaches the servo on pin 3 to the servo object
  updown.attach(9);  //attach servo to in 9
  pinMode(mouth, OUTPUT);
  pinMode(startPinIn, INPUT);
  pinMode(donePinOut, OUTPUT);
  analogWrite(donePinOut, 0);
  pinMode(powerOnPinOut, OUTPUT);
  //Serial.println(9999);
  display.begin(SSD1306_SWITCHCAPVCC, 0x3C);
  I2C_SLA = 0x078;
  Otto.init(11,11,11,11,false, -1, 12, 8, 9); //connect buzzer to pin 12
  Otto.sing(S_connection);
  display.clearDisplay();
  display.display();
  Serial.println("Display cleared");
  //updown.write (180);
  updown.write (80);
  myservo.write(79);
  analogWrite(powerOnPinOut, 180); //PWM noin 3.5v (ESP vaatii)
  pinMode(doorlock,OUTPUT);
  digitalWrite(doorlock,HIGH);
}
int m=0;

void loop(void) 

{
  //Serial.println("luuppi alkaa");
  //digitalWrite(mouth,HIGH);
  //delay(1000);
  //digitalWrite(mouth,LOW);
  //delay(1000);
  NNvalue= digitalRead(startPinIn);
  //Serial.println(NNvalue);
  if (NNvalue ==1)
  {
if (m==0)
{
  Serial.println("m0 alkaa");
  //I2C_SLA = 0x078; 
  //display.clearDisplay();
  //delay(1000);
  //u8g.drawBitmapP( 40, 16, 6, 48, test);
  //display.display();
  //delay(1000);
  
  //for (ud = 180; ud >= 80; ud -= 0.7) 
  for (ud = 100; ud >= 80; ud -= 0.7) 
  { 
    updown.write(ud); 
    //Serial.println("ud:n arvo");
    //Serial.println(ud);  
    delay(15);
    //delay(150); 
    
    
    m=1;
   
    digitalWrite(mouth,HIGH);
    
  }
   Otto.sing(S_connection);  
}


  //Serial.print(cm);
//  Serial.print("cm");
 // Serial.println();
 /* if (cm<= 65)
  {
  digitalWrite(mouth, HIGH);   // turn the LED on (HIGH is the voltage level)
  delay(300);                       // wait for a second
  digitalWrite(mouth, LOW);    // turn the LED off by making the voltage LOW
  delay(100); 
  } */
  
  if (m==1) //% bar
  {
    Serial.println("m1 alkaa");
    digitalWrite(mouth,LOW);
  display.clearDisplay();
  //display.display();
  drawPercentbar( 2, 16, 100, 15,p2);
  
   cmdinput=false;
   p2++;
   display.display();
   
    if( p2 > 100) 
    {
      p2 =0;
       
       digitalWrite(mouth,HIGH);
      delay(100);
       digitalWrite(mouth,LOW);
       delay(100);
       Otto.sing(S_connection);  
        digitalWrite(mouth,HIGH);
        delay(100);
       digitalWrite(mouth,LOW);
       delay(100);
      
      m=2 ;
      
    }
  }

 if (m==2) //box display
 {
  Serial.println("m2 alkaa");
  digitalWrite(mouth,HIGH);
      delay(100);
       digitalWrite(mouth,LOW);
       delay(100);
  Otto.sing(S_fart1);
  digitalWrite(mouth,HIGH);
      delay(100);
       digitalWrite(mouth,LOW);
       delay(100);
    cmd=0;  
    I2C_SLA = 0x078;
    u8g.firstPage();  
  do {
    draw(cmd);
  } while( u8g.nextPage() );
  
    I2C_SLA = 0x07A;
    u8g.firstPage();  
  do {
    draw(cmd);
  } while( u8g.nextPage() );
  //Serial.println("Mikä liike tämä on 2");

// -------------------------------------------
  for (pos = 79; pos >= 10; pos -= 1) { // goes from 180 degrees to 0 degrees
    myservo.write(pos);              // tell servo to go to position in variable 'pos'
    delay(25);                       // waits 15ms for the servo to reach the position
  }
  
  for (pos = 10; pos <= 79; pos += 1) { // goes from 0 degrees to 180 degrees
    // in steps of 1 degre
    myservo.write(pos);              // tell servo to go to position in variable 'pos'
    delay(25);                       // waits 15ms for the servo to reach the position
  }

   for (pos = 79; pos <= 160; pos += 1) { // goes from 0 degrees to 180 degrees
    // in steps of 1 degree
    myservo.write(pos);              // tell servo to go to position in variable 'pos'
    delay(25);                       // waits 15ms for the servo to reach the position
  }
   for (pos = 160; pos >= 79; pos -= 1) { // goes from 180 degrees to 0 degrees
    myservo.write(pos);              // tell servo to go to position in variable 'pos'
    delay(25);                       // waits 15ms for the servo to reach the position
  }

delay (3000);
   m=3;  
 }
 
  if (m==3)
{ 
  Serial.println("m3 alkaa");
  cmd=2;  //Heart display
     digitalWrite(mouth,HIGH);
      delay(100);
       digitalWrite(mouth,LOW);
       delay(100);
Otto.sing(S_disconnection);
 digitalWrite(mouth,HIGH);
      delay(100);
       digitalWrite(mouth,LOW);
       delay(100);
     I2C_SLA = 0x078;
     u8g.firstPage();  
  do {
    draw(cmd);
  } while( u8g.nextPage() );
  
    I2C_SLA = 0x07A;
    u8g.firstPage();  
  do {
    draw(cmd);
  } while( u8g.nextPage() );

  
delay (3000);
 m=4; 
}
// -------------------------------------------

if (m==4) //box display
{ 
  Serial.println("m4 alkaa");
cmd=1;  
 analogWrite(donePinOut, 180);    
 Otto.sing(S_happy);
  digitalWrite(mouth,HIGH);
      delay(100);
       digitalWrite(mouth,LOW);
       delay(100);
        digitalWrite(mouth,HIGH);
        delay(100);
       digitalWrite(mouth,LOW);
       delay(100);
for (pos = 79; pos >= 10; pos -= 1) { // goes from 180 degrees to 0 degrees
    myservo.write(pos);              // tell servo to go to position in variable 'pos'
    delay(25);                       // waits 15ms for the servo to reach the position
  }
  
     I2C_SLA = 0x078;
     u8g.firstPage();  
  do {
    draw(cmd);
  } while( u8g.nextPage() );
  
    I2C_SLA = 0x07A;
    u8g.firstPage();  
  do {
    draw(cmd);
  } while( u8g.nextPage() );
  
  //digitalWrite(doorlock,LOW);
  //digitalWrite(donePinOut, HIGH);
  
delay (3000);
 m=5;
 //Serial.println("m on 5 eli loppu");
  }
  
  if (m==5)
  {
  Serial.println("m5 alkaa");
  //Serial.println("Mikä liike tämä on 1"); 
    for (pos = 10; pos <= 79; pos += 1) { // goes from 180 degrees to 0 degrees
    myservo.write(pos);              // tell servo to go to position in variable 'pos'
    //Serial.println("pos");
    //Serial.println(pos);
    delay(25);                       // waits 15ms for the servo to reach the position
  }

  
  /*
  for (ud = 80; ud <= 180; ud += 0.7) 
  { 
    updown.write(ud);
    //Serial.println("ud");
    //Serial.println(ud);
    delay(15);
    //delay(150); 
    //m=1;
  }
 
   display.clearDisplay();
   int i;
   for(i=0; i<display.width(); i+=4) {
    display.drawLine(0, 0, i, display.height()-1, BLACK);
    display.display(); // Update screen with each newly-drawn line
    delay(1);
  }
*/
  Serial.println("nollaa näyttö");
  //display.clearDisplay();
  //display.display();
  
     I2C_SLA = 0x078;
     u8g.firstPage();
     cmd=3;  
  do {
    draw(cmd);
  } while( u8g.nextPage() );

  /*
    I2C_SLA = 0x07A;
    u8g.firstPage();  
  do {
    draw(cmd);
  } while( u8g.nextPage() );

  
      I2C_SLA = 0x07A;
      u8g.firstPage(); 
    do {
       uint8_t i, j;
  for( i = 0; i < 16; i++ )
    for( j = 0; j < 30; j++ )
      screen[i][j] = 0;  
    } while( u8g.nextPage() );
  //clearOLED();
*/
   //Otto.sing(S_connection); 
   //Serial.println(m=6);
   //analogWrite(donePinOut, 180); // Siirretty aikaisemmaksi
   //Serial.println("donePinOut");
   //Serial.println(analogRead(donePinOut));
   analogWrite(donePinOut, 0);
   delay(5000);
   //analogWrite(donePinOut, 0);
   m=6;
   Serial.println(m=6);
   m=0; 
  }
}

}
  
// ------------------------------------------- 




void draw(byte d) {
  
if (d==0)  u8g.drawBitmapP( 40, 16, 6, 48, normal);
if (d==1)  u8g.drawBitmapP( 40, 16, 6, 48, spiral);
if (d==2)  u8g.drawBitmapP( 40, 16, 6, 48, heart1);
if (d==3)  u8g.drawBitmapP( 40, 16, 6, 48, test);
}

void drawPercentbar(int x,int y, int width,int height, int progress)
{
  
   progress = progress > 100 ? 100 : progress;
   progress = progress < 0 ? 0 :progress;
   display.setCursor(19, 5 );
   display.print("Copying data");
   float bar = ((float)(width-4) / 100) * progress; 
  
   display.drawRect(x, y, width, height, WHITE);
   display.fillRect(x+2, y+2, bar , height-4, WHITE);
   
 
  // Display progress text
  if( height >= 15){
    display.setCursor((width/2) -3, y+5 );
    display.setTextSize(1);
    display.setTextColor(WHITE);
   if( progress >=50)
     display.setTextColor(BLACK, WHITE); // 'inverted' text
     
     display.print(progress);
    display.print("%");
  } 
  }

  void clearOLED(){
    u8g.firstPage(); 
    do {
    } while( u8g.nextPage() );
}
 
  
 
